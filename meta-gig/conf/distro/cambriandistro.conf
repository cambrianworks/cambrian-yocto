## meta-gig/conf/distro/cambriandistro.conf
```bitbake
require conf/distro/tegrademo.conf

DISTRO = "cambriandistro"
DISTRO_NAME = "Cambrian Yocto Distribution"
DISTRO_VERSION = "2.0.1"
```

## meta-gig/conf/distro/cambrianyocto.conf
```bitbake
require conf/distro/tegrademo.conf

DISTRO = "cambrianyocto"
DISTRO_NAME = "Cambrian Yocto Distribution"
DISTRO_VERSION = "2.0.0"
```

## meta-gig/conf/layer.conf
```bitbake
BBPATH =. "${LAYERDIR}:"
BBFILES += "${LAYERDIR}/recipes-*/*/*.bb ${LAYERDIR}/recipes-*/*/*.bbappend"

BBFILE_COLLECTIONS += "gig"
BBFILE_PATTERN_gig = "^${LAYERDIR}/"
BBFILE_PRIORITY_gig = "50"

LAYERVERSION_gig = "1"
LAYERSERIES_COMPAT_gig = "scarthgap"
LAYERDEPENDS_gig = "tegra"

TD_DISTRO_LAYERDIR = "${LAYERDIR}"
```

## meta-gigcompute/conf/layer.conf
```bitbake
BBPATH =. "${LAYERDIR}:"
BBFILES += "${LAYERDIR}/recipes-*/*/*.bb ${LAYERDIR}/recipes-*/*/*.bbappend"

BBFILE_COLLECTIONS += "gigcompute"
BBFILE_PATTERN_gigcompute = "^${LAYERDIR}/"
BBFILE_PRIORITY_gigcompute = "50"

LAYERVERSION_gigcompute = "1"
LAYERSERIES_COMPAT_gigcompute = "scarthgap"
LAYERDEPENDS_gigcompute = "tegra"

TD_DISTRO_LAYERDIR = "${LAYERDIR}"
```

## meta-gigcompute/conf/machine/gigcompute-nano-devkit.conf
```bitbake
#@TYPE: Machine
#@NAME: Jetson Orin Nano with SD card (P3701-0000)
#@DESCRIPTION: Jetson Orin Nano with SD card target for GigCompute platform.

TEGRA_BOARDSKU ?= "0005"
PARTITION_LAYOUT_TEMPLATE_DEFAULT ?= "flash_t234_qspi_sd.xml"

PREFERRED_PROVIDER_virtual/sh = "bash"
PREFERRED_PROVIDER_base-utils = "coreutils"
VIRTUAL-RUNTIME_base-utils = "coreutils"

MACHINEOVERRIDES =. "gig:"

require conf/machine/include/orin-nano.inc
```

## meta-gigrouter/conf/layer.conf
```bitbake
BBPATH =. "${LAYERDIR}:"
BBFILES += "${LAYERDIR}/recipes-*/*/*.bb ${LAYERDIR}/recipes-*/*/*.bbappend"

BBFILE_COLLECTIONS += "gigrouter"
BBFILE_PATTERN_gigrouter = "^${LAYERDIR}/"
BBFILE_PRIORITY_gigrouter = "50"

LAYERVERSION_gigrouter = "1"
LAYERSERIES_COMPAT_gigrouter = "scarthgap"
LAYERDEPENDS_gigrouter = "tegra"

# This is used by the tegra-distro-sanity bbclass
# to identify the distro layer directory during
# bblayers checks.
TD_DISTRO_LAYERDIR = "${LAYERDIR}"
```

## meta-gigrouter/conf/machine/gigrouter-nano-devkit.conf
```bitbake
#@TYPE: Machine
#@NAME: Jetson Orin Nano with SD card (P3701-0000)
#@DESCRIPTION: Jetson Orin Nano with SD card target for GigRouter platform.

TEGRA_BOARDSKU ?= "0005"
PARTITION_LAYOUT_TEMPLATE_DEFAULT ?= "flash_t234_qspi_sd.xml"

require conf/machine/include/orin-nano.inc
```
